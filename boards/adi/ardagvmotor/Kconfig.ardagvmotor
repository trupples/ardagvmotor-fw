## boards/adi/ardagvmotor/Kconfig.ardagvmotor
```kconfig
# Copyright (c) 2024 Analog Devices, Inc.
# SPDX-License-Identifier: Apache-2.0

config BOARD_ARDAGVMOTOR
    select SOC_MAX32662
```

## boards/adi/ardagvmotor/ardagvmotor_defconfig
```kconfig
# Copyright (c) 2024 Analog Devices, Inc.
# SPDX-License-Identifier: Apache-2.0

# Enable GPIO
CONFIG_GPIO=y

# Console
CONFIG_CONSOLE=y
CONFIG_UART_CONSOLE=y

# Enable UART
CONFIG_SERIAL=y
CONFIG_UART_INTERRUPT_DRIVEN=y

# Enable SPI
CONFIG_SPI=y

# Enable I2C
CONFIG_I2C=y

# Enable CAN
CONFIG_CAN=y
```

## boards/adi/ardagvmotor/board.yml
```yaml
board:
  name: ardagvmotor
  full_name: ADI Arduino AGV Motor Control
  vendor: adi
  revision:
    format: letter
    default: B
    revisions:
    - name: A
    - name: B
  socs:
  - name: max32662
```
